## zephyrproject/zephyr/boards/riscv/neorv32/Kconfig.defconfig
```kconfig
# Copyright (c) 2021 Henrik Brix Andersen <henrik@brixandersen.dk>
# SPDX-License-Identifier: Apache-2.0

if BOARD_NEORV32

config BOARD
	default "neorv32"

config BUILD_OUTPUT_BIN
	default y

endif # BOARD_NEORV32
```
